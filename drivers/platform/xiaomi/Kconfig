## drivers/platform/xiaomi/Kconfig
```kconfig
# Xiaomi configuration options

config MACH_XIAOMI
	bool "Xiaomi board"
	depends on ARCH_QCOM
	help
	 Support for Xiaomi boards.

config MACH_XIAOMI_SDM660
	bool "Xiaomi SDM660 boards"
	depends on ARCH_SDM660
	select MACH_XIAOMI
	help
	 Support for SDM660 Xiaomi boards.

menu "Xiaomi board selection"

config MACH_WHYRED
	bool "whyred board"
	select MACH_XIAOMI_SDM660
	help
	 Support for Xiaomi Redmi Note 5 Pro, codenamed whyred.

config MACH_WAYNE
	bool "wayne board"
	select MACH_XIAOMI_SDM660
	help
	 Support for Xiaomi Mi 6X, codenamed wayne.

endmenu
```
